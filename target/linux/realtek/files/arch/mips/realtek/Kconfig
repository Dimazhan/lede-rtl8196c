## target/linux/realtek/files/arch/mips/realtek/Kconfig
```kconfig
if REALTEK

menu "Realtek RLX based machine selection"

config REALTEK_MACH_GENERIC
	bool "Generic Realtek RLX based board"

config REALTEK_MACH_A3002RU
	bool "TOTOLINK A3002RU board"
	help
	  Say 'Y' here if you want to support the
	  TOTOLINK A3002RU board.

config REALTEK_MACH_AU_HOME_SPOT_CUBE
	bool "AU HOME SPOT CUBE board"
	help
	  Say 'Y' here if you want your kernel to support the
	  AU HOME SPOT CUBE board.

endmenu

endif
```
